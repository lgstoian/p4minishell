## components/networking/Kconfig.projbuild
```kconfig
menu "P4MiniShell"

config P4MINISHELL_WIFI_DEFAULT_SSID
    string "Default Wi-Fi SSID"
    default ""
    help
        Default station SSID used when the shell command `wifi connect` is
        entered without explicit credentials.

config P4MINISHELL_WIFI_DEFAULT_PASSWORD
    string "Default Wi-Fi password"
    default ""
    help
        Default station password used when the shell command `wifi connect` is
        entered without explicit credentials.

config P4MINISHELL_WIFI_BOOT_DIAGNOSTIC
    bool "Run Wi-Fi diagnostic scan at boot"
    default n
    help
        When enabled, the boot-time Wi-Fi background task performs a scan and
        prints a diagnostic report. On esp_hosted 2.12.1 with IDF 5.5.5 this
        scan frequently corrupts heap metadata and crashes the board during a
        later station connect, so it is disabled by default. The `wifi diag`
        command can still be run manually.

endmenu
```

## coprocessor/esp32c6_slave/main/Kconfig.projbuild
```kconfig
rsource "../../../managed_components/espressif__esp_hosted/slave/main/Kconfig.projbuild"
```

## coprocessor/esp32c6_slave/sdkconfig.defaults
```kconfig
# ESP-Hosted 3.x C6 coprocessor configuration for ESP32-P4-Function-EV-Board

# 1. Role
CONFIG_ESP_HOSTED=y
CONFIG_ESP_HOSTED_CP=y
CONFIG_ESP_HOSTED_CP_FOR_MCU=y
CONFIG_ESP_HOSTED_P4_DEV_BOARD_FUNC_BOARD=y

# 2. CPU
CONFIG_ESP_DEFAULT_CPU_FREQ_MHZ_160=y

# 3. BT Configuration
CONFIG_BT_ENABLED=y
CONFIG_BT_CONTROLLER_ONLY=y
CONFIG_BT_BLUEDROID_ENABLED=
CONFIG_BT_LE_SLEEP_ENABLE=y
CONFIG_BT_LE_HCI_INTERFACE_USE_RAM=y

# 4. Partition Table
CONFIG_ESPTOOLPY_FLASHSIZE_4MB=y
CONFIG_PARTITION_TABLE_CUSTOM=y
CONFIG_PARTITION_TABLE_CUSTOM_FILENAME="partitions.esp32c6.csv"

# 5. Mempool
CONFIG_ESP_CACHE_MALLOC=y

# 6. Features
CONFIG_ESP_HOSTED_CP_FEAT_RPC=y
CONFIG_ESP_HOSTED_CP_FEAT_SYSTEM=y
CONFIG_ESP_HOSTED_CP_FEAT_WIFI=y
CONFIG_ESP_HOSTED_CP_FEAT_BT=y
CONFIG_ESP_HOSTED_CP_FEAT_BT_HCI_VHCI=y

# 7. Transport config (SDIO is default on C6)
# ESP_HOSTED_TRANSPORT_CP_SDIO_STREAMING_MODE=y

# 8. WiFi config
CONFIG_ESP_WIFI_NVS_ENABLED=y
CONFIG_ESP_WIFI_ENTERPRISE_SUPPORT=n

CONFIG_ESP_WIFI_STATIC_RX_BUFFER_NUM=20
CONFIG_ESP_WIFI_DYNAMIC_RX_BUFFER_NUM=64
CONFIG_ESP_WIFI_DYNAMIC_TX_BUFFER_NUM=64
CONFIG_ESP_WIFI_AMPDU_TX_ENABLED=y
CONFIG_ESP_WIFI_TX_BA_WIN=32
CONFIG_ESP_WIFI_AMPDU_RX_ENABLED=y
CONFIG_ESP_WIFI_RX_BA_WIN=32

CONFIG_ESP_WIFI_RX_IRAM_OPT=y
CONFIG_ESP_WIFI_IRAM_OPT=y

# 9. LWIP config
CONFIG_LWIP_TCP_SND_BUF_DEFAULT=11520
CONFIG_LWIP_TCP_WND_DEFAULT=11520
CONFIG_LWIP_TCP_RECVMBOX_SIZE=16
CONFIG_LWIP_UDP_RECVMBOX_SIZE=16
CONFIG_LWIP_TCPIP_RECVMBOX_SIZE=32
CONFIG_LWIP_TCP_SACK_OUT=y
CONFIG_LWIP_TCPIP_CORE_LOCKING=y
CONFIG_LWIP_TCPIP_CORE_LOCKING_INPUT=y

# 10. Optimizations
CONFIG_COMPILER_OPTIMIZATION_PERF=y
CONFIG_BOOTLOADER_COMPILER_OPTIMIZATION_PERF=y

# 11. FreeRTOS
CONFIG_FREERTOS_HZ=1000
```

## main/Kconfig.projbuild
```kconfig
menu "P4MiniShell"

config P4MINISHELL_C6_FLASH_UART_PORT
    int "ESP32-C6 flasher UART port"
    default 1
    range 0 5
    help
        Dedicated UART used by the P4 host to flash the ESP32-C6 with esp-serial-flasher.

config P4MINISHELL_C6_FLASH_UART_TX_GPIO
    int "ESP32-C6 flasher UART TX GPIO"
    default -1
    range -1 54
    help
        P4 TX GPIO routed to the ESP32-C6 RX pin for serial flashing.

config P4MINISHELL_C6_FLASH_UART_RX_GPIO
    int "ESP32-C6 flasher UART RX GPIO"
    default -1
    range -1 54
    help
        P4 RX GPIO routed to the ESP32-C6 TX pin for serial flashing.

config P4MINISHELL_C6_FLASH_UART_BAUDRATE
    int "ESP32-C6 flasher UART baudrate"
    default 115200
    range 9600 5000000
    help
        UART baudrate used for the ESP32-C6 ROM loader session.

config P4MINISHELL_C6_EN_GPIO
    int "ESP32-C6 EN GPIO"
    default -1
    range -1 54
    help
        Optional P4 GPIO wired to ESP32-C6 EN to hold the co-processor enabled during flashing.

config P4MINISHELL_C6_RESET_GPIO
    int "ESP32-C6 reset GPIO"
    default -1
    range -1 54
    help
        P4 GPIO used to reset the ESP32-C6 into and out of ROM download mode.
        If left unset, the updater falls back to toggling the EN GPIO instead.

config P4MINISHELL_C6_BOOT_GPIO
    int "ESP32-C6 BOOT GPIO"
    default -1
    range -1 54
    help
        P4 GPIO wired to ESP32-C6 GPIO0/BOOT for entering ROM download mode.

config P4MINISHELL_WIFI_DEFAULT_SSID
    string "Default Wi-Fi SSID"
    default ""
    help
        Default station SSID used when the shell command `wifi connect` is
        entered without explicit credentials.

config P4MINISHELL_WIFI_DEFAULT_PASSWORD
    string "Default Wi-Fi password"
    default ""
    help
        Default station password used when the shell command `wifi connect` is
        entered without explicit credentials.

endmenu
```
